## drivers/interrupt_controller/Kconfig.brcm
```kconfig
# Copyright (c) 2026 Jonathan Elliot Peace <jep@alphabetiq.com>
# SPDX-License-Identifier: Apache-2.0

config BCM2836_L1_INTC
	bool "BCM2836 ARM-local interrupt controller"
	default y
	depends on DT_HAS_BRCM_BCM2836_L1_INTC_ENABLED
	help
	  Driver for the BCM2836 ARM-local interrupt controller (also
	  present on BCM2710 / Pi Zero 2 W). Routes per-core ARM
	  generic timer IRQs, four mailbox IRQs per core, the per-core
	  PMU IRQ, and the cascaded GPU IRQ to the parent controller of
	  the ARM CPU IRQ line.

config BCM2835_ARMCTRL_IC
	bool "BCM2835 ARMC peripheral interrupt controller"
	default y
	depends on DT_HAS_BRCM_BCM2835_ARMCTRL_IC_ENABLED
	help
	  Driver for the BCM2835 ARMC peripheral interrupt controller --
	  the "GPU IRQ" side of the BCM283x family. On BCM2710 (Pi Zero
	  2 W) it cascades under the BCM2836 ARM-local intc; on BCM2835
	  (Pi 1 / Pi Zero W) it is the root controller wired directly to
	  the ARM core IRQ line.

config RP1_IRQ
	bool "Raspberry Pi RP1 MSI-X interrupt controller"
	default y
	depends on DT_HAS_RASPBERRYPI_RP1_IRQ_ENABLED
	depends on ARM64
	depends on PCIE
	help
	  Driver for the interrupt controller of the RP1 PCIe south
	  bridge found on the Raspberry Pi 5. The RP1 raises one MSI-X
	  vector per internal interrupt source; the BCM2712 MSI
	  interrupt proxy converts each vector into a GIC SPI. The
	  driver programs the MSI-X table, unmasks the host side of the
	  proxy and exposes the RP1 sources above the GIC SPI range.

config RP1_IRQ_INIT_PRIORITY
	int "RP1 interrupt controller init priority"
	default 42
	depends on RP1_IRQ
	help
	  Initialisation priority of the RP1 interrupt controller. It
	  must run after the PCIe root complex (CONFIG_PCIE_INIT_PRIORITY)
	  because it reads the RP1 configuration space, and before the
	  serial drivers that enable RP1 UART interrupts.
```

## dts/bindings/fuel-gauge/adi,ltc3337.yaml
```yaml
# Copyright (c) 2026 Federico Borgo
# SPDX-License-Identifier: Apache-2.0

description: |
  Analog Devices LTC3337 primary battery state of health monitor with
  precision coulomb counter.

  The accumulated charge is reported as FUEL_GAUGE_REMAINING_CAPACITY_UAH. Note
  that the chip counts the charge drawn from the battery, so the value grows
  as the battery discharges.

compatible: "adi,ltc3337"

include: [base.yaml, i2c-device.yaml, fuel-gauge.yaml]

properties:
  reg:
    required: true

  ipeak-milliamp:
    type: int
    required: true
    enum:
      - 5
      - 10
      - 15
      - 20
      - 25
      - 50
      - 75
      - 100
    description: |
      Peak input current selected by the IPK[2:0] pins (datasheet Table 1).
      The pins are hard wired, so this value must match the board. It sets
      the charge represented by one counter LSB. The driver compares it with
      the pin state read back from the chip and warns on a mismatch.
```

## dts/bindings/interrupt-controller/brcm,bcm2712-mip.yaml
```yaml
# Copyright (c) 2026 Process Mission
# SPDX-License-Identifier: Apache-2.0

description: |
  Broadcom BCM2712 MSI interrupt proxy (MIP).

  The MIP receives MSI/MSI-X writes from PCIe endpoints and raises a
  GIC SPI for each write. Each MSI vector maps to one SPI:

    SPI = brcm,msi-base-spi + brcm,msi-offset + vector

  The Raspberry Pi 5 routes the RP1 south bridge through mip0.

compatible: "brcm,bcm2712-mip"

include: [interrupt-controller.yaml, base.yaml]

properties:
  reg:
    required: true

  msi-controller:
    type: boolean
    required: true

  brcm,msi-base-spi:
    type: int
    required: true
    description: First GIC SPI used for MSI vectors.

  brcm,msi-num-spis:
    type: int
    required: true
    description: Number of consecutive SPIs used for MSI vectors.

  brcm,msi-offset:
    type: int
    default: 0
    description: Offset added to the MSI data to obtain the vector number.

  brcm,msi-pci-addr:
    type: array
    required: true
    description: |
      PCIe bus address that endpoints write to in order to raise an
      MSI, as two cells (high, low).
```

## dts/bindings/interrupt-controller/raspberrypi,rp1-irq.yaml
```yaml
# Copyright (c) 2026 Process Mission
# SPDX-License-Identifier: Apache-2.0

description: |
  Raspberry Pi RP1 MSI-X interrupt controller.

  The RP1 exposes one MSI-X vector per internal interrupt source. The
  vectors are routed through the BCM2712 MSI interrupt proxy to GIC
  SPIs. Zephyr keeps the RP1 sources in their own IRQ range, above the
  GIC SPI range; see
  <zephyr/dt-bindings/interrupt-controller/rp1-irq.h>.

  The driver locates the RP1 in the configuration space of the PCIe
  root complex that parents this node, programs the MSI-X table and
  unmasks the host side of the MSI proxy.

compatible: "raspberrypi,rp1-irq"

include: [interrupt-controller.yaml, base.yaml]

properties:
  reg:
    required: true
    description: |
      MSI-X CFG register block, i.e. the RP1 PCIe APBS window at
      offset 0x108000.

  msi-parent:
    type: phandle
    required: true
    description: MSI controller that receives the RP1 MSI-X writes.

interrupt-cells:
  - irq
  - flags
  - priority
```
