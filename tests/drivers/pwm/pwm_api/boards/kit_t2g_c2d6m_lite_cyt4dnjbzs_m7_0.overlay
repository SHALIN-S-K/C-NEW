/*
 * SPDX-FileCopyrightText: Copyright (c) 2026 Infineon Technologies AG,
 * SPDX-FileCopyrightText: or an affiliate of Infineon Technologies AG. All rights reserved.
 * SPDX-FileCopyrightText: Copyright (c) 2026 Linumiz
 *
 * SPDX-License-Identifier: Apache-2.0
 */

#include "kit_t2g_c2d6m_lite_common.overlay"

/ {
	aliases {
		pwm-test = &pwm0_26;
	};
};

&tcpwm0_26 {
	clock-frequency = <1000000>;
	status = "okay";
};

&pwm0_26 {
	clocks = <&peri0_group0_16bit_0>;
	pinctrl-0 = <&p7_6_pwm0_26>;
	pinctrl-names = "default";
	status = "okay";
};
